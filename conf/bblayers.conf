## conf/bblayers.conf
```bitbake
# POKY_BBLAYERS_CONF_VERSION is increased each time build/conf/bblayers.conf
# changes incompatibly
POKY_BBLAYERS_CONF_VERSION = "2"

BBPATH = "${TOPDIR}"
BBFILES ?= ""

BBLAYERS ?= " \
    ${TOPDIR}/../yocto/poky-morty/meta \
    ${TOPDIR}/../yocto/poky-morty/meta-poky \
    ${TOPDIR}/../yocto/poky-morty/meta-openembedded/meta-oe \
    ${TOPDIR}/../yocto/poky-morty/meta-openembedded/meta-multimedia \
    ${TOPDIR}/../yocto/poky-morty/meta-openembedded/meta-networking \
    ${TOPDIR}/../yocto/poky-morty/meta-openembedded/meta-python \
    ${TOPDIR}/../yocto/poky-morty/meta-openembedded/meta-webserver \
    ${TOPDIR}/../yocto/poky-morty/meta-qt5 \
    ${TOPDIR}/../yocto/poky-morty/meta-raspberrypi \
    ${TOPDIR}/../meta-brewpi \
  "
```
